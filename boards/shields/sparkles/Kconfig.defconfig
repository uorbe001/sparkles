## boards/shields/sparkles/Kconfig.defconfig
```kconfig
if SHIELD_SPARKLES_LEFT

# Name must be less than 16 characters long!
config ZMK_KEYBOARD_NAME
    default "Sparkles"

config ZMK_SPLIT_ROLE_CENTRAL
    default y

endif

if SHIELD_SPARKLES_LEFT || SHIELD_SPARKLES_RIGHT

config ZMK_SPLIT
    default y

endif
```

## boards/shields/sparkles/Kconfig.shield
```kconfig
# No whitespace after the comma or in your part name!
config SHIELD_SPARKLES_LEFT
    def_bool $(shields_list_contains,sparkles_left)

# No whitespace after the comma or in your part name!
config SHIELD_SPARKLES_RIGHT
    def_bool $(shields_list_contains,sparkles_right)
```
